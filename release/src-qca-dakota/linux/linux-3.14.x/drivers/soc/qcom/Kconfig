## release/src-qca-dakota/linux/linux-3.14.x/sound/soc/qca/Kconfig
```kconfig
# Copyright (c) 2015 The Linux Foundation. All rights reserved.
#
# Permission to use, copy, modify, and/or distribute this software for any
# purpose with or without fee is hereby granted, provided that the above
# copyright notice and this permission notice appear in all copies.
#
# THE SOFTWARE IS PROVIDED "AS IS" AND THE AUTHOR DISCLAIMS ALL WARRANTIES
# WITH REGARD TO THIS SOFTWARE INCLUDING ALL IMPLIED WARRANTIES OF
# MERCHANTABILITY AND FITNESS. IN NO EVENT SHALL THE AUTHOR BE LIABLE FOR
# ANY SPECIAL, DIRECT, INDIRECT, OR CONSEQUENTIAL DAMAGES OR ANY DAMAGES
# WHATSOEVER RESULTING FROM LOSS OF USE, DATA OR PROFITS, WHETHER IN AN
# ACTION OF CONTRACT, NEGLIGENCE OR OTHER TORTIOUS ACTION, ARISING OUT OF
# OR IN CONNECTION WITH THE USE OR PERFORMANCE OF THIS SOFTWARE.

config SND_QCA_SOC
	tristate "SoC Audio for QCA based platforms"
	depends on ARCH_QCOM
	help
	  Say Y or M if you want to add support for QCA platforms
	  QCA SoC supports following interfaces
	  I2S, TDM and SPDIF
	  Also select IPQ40xx platform

config SND_QCA_SOC_IPQ40XX
	tristate "SoC Audio support for IPQ40xx (Dakota) based platforms"
	depends on ARCH_QCOM && SND_QCA_SOC
	select SND_SOC_WCD934X
	select SND_SOC_WSA881X
	select SND_IPQ40XX_SOC_PCM_I2S
	select SND_IPQ40XX_SOC_PCM_TDM
	select SND_IPQ40XX_SOC_PCM_SPDIF
	select SND_IPQ40XX_SOC_CPU_DAI
	select SND_IPQ40XX_SOC_PCM_RAW
	select SND_IPQ40XX_SOC_ADSS
	select SND_IPQ40XX_SOC_STEREO
	select SND_IPQ40XX_SOC_MBOX
	help
	  Say Y or M if you want to add support for IPQ40xx platforms

config SND_IPQ40XX_SOC_CODEC
	tristate "SoC Audio CODEC support for IPQ40xx"
	depends on ARCH_QCOM && SND_QCA_SOC
	help
	  Say Y or M if you want to add CODEC support for IPQ40xx platforms

config SND_IPQ40XX_SOC_PCM_I2S
	tristate
	depends on SND_QCA_SOC

config SND_IPQ40XX_SOC_PCM_TDM
	tristate
	depends on SND_QCA_SOC

config SND_IPQ40XX_SOC_PCM_SPDIF
	tristate
	depends on SND_QCA_SOC

config SND_IPQ40XX_SOC_CPU_DAI
	tristate
	depends on SND_QCA_SOC

config SND_IPQ40XX_SOC_PCM_RAW
	tristate
	depends on SND_QCA_SOC

config SND_IPQ40XX_SOC_ADSS
	tristate
	depends on SND_QCA_SOC

config SND_IPQ40XX_SOC_STEREO
	tristate
	depends on SND_QCA_SOC

config SND_IPQ40XX_SOC_MBOX
	tristate
	depends on SND_QCA_SOC
```
