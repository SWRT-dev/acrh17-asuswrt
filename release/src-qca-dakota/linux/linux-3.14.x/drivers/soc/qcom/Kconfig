## release/src-qca-dakota/linux/linux-3.14.x/drivers/video/msm/Kconfig
```kconfig
config FB_MSM
	tristate "MSM Framebuffer support"
	depends on FB && ARCH_QCOM
	select FB_BACKLIGHT if FB_MSM_BACKLIGHT
	select NEW_LEDS
	select LEDS_CLASS
	select FB_CFB_FILLRECT
	select FB_CFB_COPYAREA
	select FB_CFB_IMAGEBLIT
	select FB_SYS_FOPS
	select FB_DEFERRED_IO
	select SYNC
	select SW_SYNC
	---help---
	  Support for MSM Framebuffer.

if FB_MSM

config FB_MSM_BACKLIGHT
	bool "Support for backlight control"
	default y
	---help---
	  Say Y here if you want to control the backlight of your display.

config FB_MSM_LOGO
	bool "MSM Frame Buffer Logo"
	default n
	---help---
	  Show /initlogo.rle during boot.

config FB_MSM_LCDC_HW
	bool
	default n

config FB_MSM_MDSS_COMMON
	bool

config FB_MSM_MDSS
	bool "MDSS HW"
	default n
	select FB_MSM_MDSS_COMMON
	---help---
	The Mobile Display Sub System (MDSS) driver supports devices which
	contain MDSS hardware block.

	The MDSS driver implements frame buffer interface to provide access to
	the display hardware and provide a way for users to display graphics
	on connected display panels.

config FB_MSM_QPIC
	bool
	select FB_MSM_MDSS_COMMON

config FB_MSM_TRIPLE_BUFFER
	bool "Support for triple frame buffer"
	---help---
	  Support for LCDC AUO WVGA(480x800) panel

config FB_MSM_LCDC_NT35582_PANEL
	depends on FB_MSM_LCDC_HW
	bool "LCDC NT35582 WVGA Panel"
	select FB_MSM_LCDC_NT35582_WVGA
	---help---
	  Support for LCDC NT35582 WVGA(480x800) panel

config FB_MSM_LCDC_SAMSUNG_OLED_PT_PANEL
	depends on FB_MSM_LCDC_HW
	bool "LCDC Samsung OLED PT Panel"
	select FB_MSM_LCDC_SAMSUNG_OLED_PT
	---help---
	  Support for LCDC Samsung OLED PT (480x800) panel

config FB_MSM_LVDS_CHIMEI_WXGA_PANEL
        bool "LVDS Chimei WXGA Panel"
        select FB_MSM_LVDS_CHIMEI_WXGA
        ---help---
          Support for LVDS Chimei WXGA(1366x768) panel

config FB_MSM_LVDS_FRC_FHD_PANEL
	bool "LVDS FRC FHD Panel"
	select FB_MSM_LVDS_FRC_FHD
	---help---
	  Support for LVDS Frc FHD(1920x1080) panel
	  FRC(Frame Rate Converter) uses LVDS as input
	  interface. It is treated as a HDMI panel with
	  1920x1080 resolution.

config FB_MSM_TRY_MDDI_CATCH_LCDC_PRISM
	depends on FB_MSM_LCDC_HW
	bool "MDDI Panel Auto Detect + LCDC Prism WVGA"
	select FB_MSM_MDDI_AUTO_DETECT
	select FB_MSM_LCDC_PRISM_WVGA
	select FB_MSM_LCDC_GORDON_VGA
	select FB_MSM_LCDC_WXGA
	select FB_MSM_LCDC_TOSHIBA_WVGA_PT
	select FB_MSM_LCDC_TOSHIBA_FWVGA_PT
	select FB_MSM_LCDC_SHARP_WVGA_PT
	select FB_MSM_LCDC_ST15_WXGA
	---help---
	  Support for MDDI panel auto detect.
	  If it can't find any MDDI panel, it will load an LCDC panel.

config FB_MSM_MIPI_PANEL_DETECT
	bool "MIPI Panel Detect"
	select FB_MSM_MIPI_TOSHIBA_VIDEO_WVGA_PT
	select FB_MSM_MIPI_TOSHIBA_VIDEO_WSVGA_PT
	select FB_MSM_MIPI_TOSHIBA_VIDEO_WUXGA
	select FB_MSM_MIPI_RENESAS_VIDEO_FWVGA_PT
	select FB_MSM_MIPI_RENESAS_CMD_FWVGA_PT
	select FB_MSM_MIPI_TRULY_VIDEO_WVGA_PT
	select FB_MSM_MIPI_NOVATEK_VIDEO_QHD_PT
	select FB_MSM_MIPI_NOVATEK_CMD_QHD_PT
	select FB_MSM_MIPI_NT35510_VIDEO_WVGA_PT
	select FB_MSM_MIPI_NT35510_CMD_WVGA_PT
	select FB_MSM_MIPI_ORISE_VIDEO_720P_PT
	select FB_MSM_MIPI_ORISE_CMD_720P_PT
	select FB_MSM_MIPI_NT35516_VIDEO_QHD_PT
	select FB_MSM_MIPI_NT35516_CMD_QHD_PT
	select FB_MSM_MIPI_SIMULATOR_VIDEO
	select FB_MSM_MIPI_CHIMEI_WXGA
	select FB_MSM_MIPI_CHIMEI_WUXGA
	---help---
	  Support for MIPI panel auto detect

config FB_MSM_MDDI_PANEL_AUTO_DETECT
	bool "MDDI Panel Auto Detect"
	select FB_MSM_MDDI_AUTO_DETECT
	---help---
	  Support for MDDI panel auto detect

config FB_MSM_LCDC_PANEL_AUTO_DETECT
	bool "LCDC Panel Auto Detect"
	select FB_MSM_LCDC_AUTO_DETECT
	select FB_MSM_LCDC_SAMSUNG_WSVGA
	select FB_MSM_LCDC_AUO_WVGA
	select FB_MSM_LCDC_NT35582_WVGA
	select FB_MSM_LCDC_SAMSUNG_OLED_PT
	---help---
	  Support for LCDC panel auto detect

config FB_MSM_LCDC_MIPI_PANEL_AUTO_DETECT
	bool "LCDC + MIPI Panel Auto Detect"
	select FB_MSM_LCDC_AUTO_DETECT
	select FB_MSM_LCDC_SAMSUNG_WSVGA
	select FB_MSM_LCDC_AUO_WVGA
	select FB_MSM_LCDC_SAMSUNG_OLED_PT
	select FB_MSM_LCDC_NT35582_WVGA
	select FB_MSM_LCDC_TOSHIBA_FWVGA_PT
	select FB_MSM_MIPI_TOSHIBA_VIDEO_WVGA_PT
	select FB_MSM_MIPI_TOSHIBA_VIDEO_WSVGA_PT
	select FB_MSM_MIPI_RENESAS_VIDEO_FWVGA_PT
	select FB_MSM_MIPI_RENESAS_CMD_FWVGA_PT
	select FB_MSM_MIPI_NOVATEK_VIDEO_QHD_PT
	select FB_MSM_MIPI_NOVATEK_CMD_QHD_PT
	select FB_MSM_MIPI_NT35510_VIDEO_WVGA_PT
	select FB_MSM_MIPI_NT35510_CMD_WVGA_PT
	select FB_MSM_MIPI_NT35516_VIDEO_QHD_PT
	select FM_MSM_MIPI_NT35516_CMD_QHD_PT
	select FB_MSM_MIPI_SIMULATOR_VIDEO
	---help---
	  Support for LCDC + MIPI panel auto detect

config FB_MSM_LVDS_MIPI_PANEL_DETECT
	bool "LVDS + MIPI Panel Auto Detect"
	select FB_MSM_LVDS_CHIMEI_WXGA
	select FB_MSM_LVDS_FRC_FHD
	select FB_MSM_MIPI_TOSHIBA_VIDEO_WVGA_PT
	select FB_MSM_MIPI_TOSHIBA_VIDEO_WSVGA_PT
	select FB_MSM_MIPI_TOSHIBA_VIDEO_WUXGA
	select FB_MSM_MIPI_RENESAS_VIDEO_FWVGA_PT
	select FB_MSM_MIPI_RENESAS_CMD_FWVGA_PT
	select FB_MSM_MIPI_TRULY_VIDEO_WVGA_PT
	select FB_MSM_MIPI_NOVATEK_VIDEO_QHD_PT
	select FB_MSM_MIPI_NOVATEK_CMD_QHD_PT
	select FB_MSM_MIPI_NT35510_VIDEO_WVGA_PT
	select FB_MSM_MIPI_NT35510_CMD_WVGA_PT
	select FB_MSM_MIPI_ORISE_VIDEO_720P_PT
	select FB_MSM_MIPI_ORISE_CMD_720P_PT
	select FB_MSM_MIPI_SIMULATOR_VIDEO
	select FB_MSM_MIPI_CHIMEI_WXGA
	select FB_MSM_MIPI_CHIMEI_WUXGA
	---help---
	  Support for LVDS + MIPI panel auto detect

config FB_MSM_MDDI_PRISM_WVGA
	bool "MDDI Prism WVGA Panel"
	select FB_MSM_MDDI
	---help---
	  Support for MDDI Prism WVGA (800x480) panel

config FB_MSM_MDDI_TOSHIBA_WVGA_PORTRAIT
	bool "MDDI Toshiba WVGA Portrait Panel"
	select FB_MSM_MDDI_TOSHIBA_COMMON
	---help---
	  Support for MDDI Toshiba WVGA (480x800) panel

config FB_MSM_MDDI_TOSHIBA_VGA
	bool "MDDI Toshiba VGA Panel"
	select FB_MSM_MDDI_TOSHIBA_COMMON_VGA
	---help---
	  Support for MDDI Toshiba VGA (480x640) and QCIF (176x220) panel

config FB_MSM_MDDI_TOSHIBA_WVGA
	bool "MDDI Toshiba WVGA panel"
	select FB_MSM_MDDI_TOSHIBA_COMMON
	---help---
	  Support for MDDI Toshiba (800x480) WVGA panel

config FB_MSM_MDDI_SHARP_QVGA_128x128
	bool "MDDI Sharp QVGA Dual Panel"
	select FB_MSM_MDDI
	---help---
	  Support for MDDI Sharp QVGA (240x320) and 128x128 dual panel

config FB_MSM_MIPI_TOSHIBA_VIDEO_WVGA_PT_PANEL
	bool "MIPI Toshiba WVGA PT Panel"
	select FB_MSM_MIPI_TOSHIBA_VIDEO_WVGA_PT

config FB_MSM_MIPI_TOSHIBA_VIDEO_WSVGA_PT_PANEL
	bool "MIPI Toshiba WSVGA PT Panel"
	select FB_MSM_MIPI_TOSHIBA_VIDEO_WSVGA_PT

config FB_MSM_MIPI_TOSHIBA_VIDEO_WUXGA_PANEL
	bool "MIPI Toshiba WUXGA (1920x1200) Panel"
	select FB_MSM_MIPI_TOSHIBA_VIDEO_WUXGA

config FB_MSM_MIPI_NOVATEK_VIDEO_QHD_PT_PANEL
	bool "MIPI NOVATEK VIDEO QHD PT Panel"
	select FB_MSM_MIPI_NOVATEK_VIDEO_QHD_PT

config FB_MSM_MIPI_NOVATEK_CMD_QHD_PT_PANEL
	bool "MIPI NOVATEK CMD QHD PT Panel"
	select FB_MSM_MIPI_NOVATEK_CMD_QHD_PT

config FB_MSM_MIPI_ORISE_VIDEO_720P_PT_PANEL
	bool "MIPI ORISE VIDEO 720P PT Panel"
	select FB_MSM_MIPI_ORISE_VIDEO_720P_PT

config FB_MSM_MIPI_ORISE_CMD_720P_PT_PANEL
	bool "MIPI ORISE CMD 720P PT Panel"
	select FB_MSM_MIPI_ORISE_CMD_720P_PT

config FB_MSM_MIPI_RENESAS_VIDEO_FWVGA_PT_PANEL
	bool "MIPI Renesas Video FWVGA PT Panel"
	select FB_MSM_MIPI_RENESAS_VIDEO_FWVGA_PT

config FB_MSM_MIPI_RENESAS_CMD_FWVGA_PT_PANEL
	bool "MIPI Renesas Command FWVGA PT Panel"
	select FB_MSM_MIPI_RENESAS_CMD_FWVGA_PT

config FB_MSM_MIPI_CHIMEI_WXGA_PANEL
	bool "MIPI Chimei WXGA PT Panel"
	select FB_MSM_MIPI_CHIMEI_WXGA

config FB_MSM_MIPI_CHIMEI_WUXGA_PANEL
	bool "MIPI Chimei WUXGA Panel"
	select FB_MSM_MIPI_CHIMEI_WUXGA

config FB_MSM_MIPI_TRULY_VIDEO_WVGA_PT_PANEL
	bool "MIPI Truly Video WVGA PT Panel"
	select FB_MSM_MIPI_TRULY_VIDEO_WVGA_PT

config FB_MSM_MIPI_NT35510_VIDEO_WVGA_PT_PANEL
	bool "MIPI NT35510 Video WVGA PT Panel"
	select FB_MSM_MIPI_NT35510_VIDEO_WVGA_PT

config FB_MSM_MIPI_NT35510_CMD_WVGA_PT_PANEL
	bool "MIPI NT35510 Command WVGA PT Panel"
	select FB_MSM_MIPI_NT35510_CMD_WVGA_PT

config FB_MSM_MIPI_NT35516_VIDEO_QHD_PT_PANEL
        bool "MIPI NT35516 Video qHD PT Panel"
        select FB_MSM_MIPI_NT35516_VIDEO_QHD_PT

config FB_MSM_MIPI_NT35516_CMD_QHD_PT_PANEL
        bool "MIPI NT35516 Command qHD PT Panel"
        select FB_MSM_MIPI_NT35516_CMD_QHD_PT

config FB_MSM_MIPI_SIMULATOR_VIDEO_PANEL
	bool "MIPI Simulator Video Panel"
	select FB_MSM_MIPI_SIMULATOR_VIDEO

config FB_MSM_EBI2_TMD_QVGA_EPSON_QCIF
	bool "EBI2 TMD QVGA Epson QCIF Dual Panel"
	select FB_MSM_EBI2
	---help---
	  Support for EBI2 TMD QVGA (240x320) and Epson QCIF (176x220) panel

config FB_MSM_HDMI_AS_PRIMARY
	depends on FB_MSM_HDMI_COMMON
	bool "Use HDMI as primary panel"
	---help---
	Support for using HDMI as primary

config FB_MSM_PANEL_NONE
	bool "NONE"
	---help---
	  This will disable LCD panel

choice
	prompt "Secondary LCD Panel"
	depends on  FB_MSM_MDP31
	default FB_MSM_SECONDARY_PANEL_NONE

config FB_MSM_LCDC_EXTERNAL_WXGA
	depends on FB_MSM_MDP31
	bool "External WXGA on LCDC"
	select FB_MSM_LCDC_PANEL
	---help---
	  Support for external WXGA display (1280x720)

config FB_MSM_HDMI_SII_EXTERNAL_720P
	depends on FB_MSM_MDP31
	bool "External SiI9022 HDMI 720P"
	select FB_MSM_LCDC_PANEL
	---help---
	  Support for external HDMI 720p display (1280x720p)
	  Using SiI9022 chipset

config FB_MSM_SECONDARY_PANEL_NONE
	bool "NONE"
	---help---
	  No secondary panel
endchoice

config FB_MSM_LCDC_DSUB
	depends on FB_MSM_LCDC_SAMSUNG_WSVGA && FB_MSM_MDP40 && FB_MSM_LCDC_HW
	bool "External DSUB support"
	default n
	---help---
	  Support for external DSUB (VGA) display up to 1440x900.  The DSUB
	  display shares the same video bus as the primary LCDC attached display.
	  Typically only one of the two displays can be used at one time.

config FB_MSM_EXT_INTERFACE_COMMON
	bool
	default n

config FB_MSM_HDMI_COMMON
	bool
	default n

config FB_MSM_HDMI_3D
	bool
	default n

config FB_MSM_HDMI_ADV7520_PANEL
	depends on FB_MSM_MDP40 && FB_MSM_OVERLAY
        bool "LCDC HDMI ADV7520 720p Panel"
        select FB_MSM_DTV
        select FB_MSM_EXT_INTERFACE_COMMON
	select FB_MSM_HDMI_COMMON
	default n
        ---help---
        Support for LCDC 720p HDMI panel attached to ADV7520

config FB_MSM_HDMI_ADV7520_PANEL_HDCP_SUPPORT
        depends on FB_MSM_HDMI_ADV7520_PANEL
        bool "Use HDCP mode"
        default y
        ---help---
          Support for HDCP mode for ADV7520 HDMI 720p Panel
          Choose to enable HDCP


config FB_MSM_HDMI_MSM_PANEL
	depends on FB_MSM_MDP40
	bool "MSM HDMI 1080p Panel"
	select FB_MSM_DTV
        select FB_MSM_EXT_INTERFACE_COMMON
	select FB_MSM_HDMI_COMMON
	select FB_MSM_HDMI_3D
	default n
	---help---
	  Support for 480p/720p/1080i/1080p output through MSM HDMI

config FB_MSM_HDMI_MSM_PANEL_DVI_SUPPORT
	depends on FB_MSM_HDMI_MSM_PANEL
	bool "Use DVI mode"
	default n
	---help---
	  Support for DVI mode for MSM HDMI 1080p Panel

config FB_MSM_HDMI_MSM_PANEL_HDCP_SUPPORT
	depends on FB_MSM_HDMI_MSM_PANEL
	bool "Use HDCP mode"
	default y
	---help---
	  Support for HDCP mode for MSM HDMI 1080p Panel
	  Choose to enable HDCP

config FB_MSM_HDMI_MSM_PANEL_CEC_SUPPORT
	depends on FB_MSM_HDMI_MSM_PANEL
	bool "Enable CEC"
	default n
	---help---
	  Support for HDMI CEC Feature
	  Choose to enable CEC

config FB_MSM_HDMI_MHL_9244
	depends on FB_MSM_HDMI_MSM_PANEL
	bool 'SI_MHL 9244 support'
	default n
	---help---
	  Support the HDMI to MHL conversion.
	  MHL (Mobile High-Definition Link) technology
	  uses USB connector to output HDMI content

config FB_MSM_HDMI_MHL_8334
	depends on FB_MSM_HDMI_MSM_PANEL
	bool 'SI_MHL 8334 support '
	default n
	---help---
	  Support the HDMI to MHL conversion.
	  MHL (Mobile High-Definition Link) technology
	  uses USB connector to output HDMI content

choice
	depends on  (FB_MSM_MDP22 || FB_MSM_MDP31 || FB_MSM_MDP40)
	prompt "TVOut Region"
	default FB_MSM_TVOUT_NONE

config FB_MSM_TVOUT_NTSC_M
	bool "NTSC M"
	select FB_MSM_TVOUT
        select FB_MSM_EXT_INTERFACE_COMMON
	---help---
	  Support for NTSC M region (North American and Korea)

config FB_MSM_TVOUT_NTSC_J
	bool "NTSC J"
	select FB_MSM_TVOUT
        select FB_MSM_EXT_INTERFACE_COMMON
	---help---
	  Support for NTSC J region (Japan)

config FB_MSM_TVOUT_PAL_BDGHIN
	bool "PAL BDGHIN"
	select FB_MSM_TVOUT
        select FB_MSM_EXT_INTERFACE_COMMON
	---help---
	  Support for PAL BDGHIN region (Non-argentina PAL-N)

config FB_MSM_TVOUT_PAL_M
	bool "PAL M"
	select FB_MSM_TVOUT
        select FB_MSM_EXT_INTERFACE_COMMON
	---help---
	  Support for PAL M region

config FB_MSM_TVOUT_PAL_N
	bool "PAL N"
	select FB_MSM_TVOUT
        select FB_MSM_EXT_INTERFACE_COMMON
	---help---
	  Support for PAL N region (Argentina PAL-N)

config FB_MSM_TVOUT_NONE
	bool "NONE"
	---help---
	  This will disable TV Out functionality.
endchoice

config FB_MSM_TVOUT_SVIDEO
	bool "TVOut on S-video"
	depends on FB_MSM_TVOUT
	default n
	---help---
	  Selects whether the TVOut signal uses S-video.
	  Choose n for composite output.

choice
	depends on  FB_MSM_MDP22
	prompt "External MDDI"
	default FB_MSM_EXTMDDI_SVGA

config FB_MSM_EXTMDDI_SVGA
	bool "External MDDI SVGA"
	select FB_MSM_MDDI
	select FB_MSM_EXTMDDI
	---help---
	  Support for MSM SVGA (800x600) external MDDI panel

config FB_MSM_EXTMDDI_NONE
	bool "NONE"
	---help---
	  This will disable External MDDI functionality.
endchoice

choice
	prompt "Default framebuffer color depth"
	depends on FB_MSM_MDP40 || FB_MSM_MDP31 || FB_MSM_MDP303
	default FB_MSM_DEFAULT_DEPTH_RGBA8888

config FB_MSM_DEFAULT_DEPTH_RGB565
	bool "16 bits per pixel (RGB565)"

config FB_MSM_DEFAULT_DEPTH_ARGB8888
	bool "32 bits per pixel (ARGB8888)"

config FB_MSM_DEFAULT_DEPTH_RGBA8888
	bool "32 bits per pixel (RGBA8888)"

endchoice

config FB_MSM_EBI2_EPSON_S1D_QVGA_PANEL
	bool "EBI2 Epson QVGA Panel"
	select FB_MSM_EBI2
	default n
	---help---
	  Support for EBI2 Epson QVGA (240x320) panel

config FB_MSM_EBI2_PANEL_DETECT
	bool "EBI2 Panel Detect"
	select FB_MSM_EBI2_EPSON_S1D_QVGA_PANEL
	default n
	---help---
	  Support for EBI2 panel auto detect

config FB_MSM_QPIC_ILI_QVGA_PANEL
	tristate "Qpic MIPI ILI QVGA Panel"
	select FB_MSM_QPIC
	---help---
	  Support for MIPI ILI QVGA (240x320) panel
	  ILI TECHNOLOGY 9341
	  with on-chip full display RAM
	  use parallel interface

config FB_MSM_QPIC_ER_SSD1963_PANEL
	tristate "Qpic MIPI ER ssd1963 Panel"
	select FB_MSM_QPIC
	---help---
	  Support for MIPI ER ssd1963  (800x480) panel
	  EAST Rising TECHNOLOGY ssd1963
	  with on-chip full display RAM
	  use 9-bit  parallel interface

config FB_MSM_QPIC_PANEL_DETECT
	bool "Qpic Panel Detect"
	select FB_MSM_QPIC_ILI_QVGA_PANEL
	---help---
	  Support for Qpic panel auto detect

if FB_MSM_MDSS
	source "drivers/video/msm/mdss/Kconfig"
endif
endif
```
