## release/src-qca-dakota/linux/linux-3.14.x/Documentation/devicetree/bindings/phy/phy-bindings.txt
```
This document explains only the device tree data binding. For general
information about PHY subsystem refer to Documentation/phy.txt

PHY device node
===============

Required Properties:
#phy-cells:	Number of cells in a PHY specifier;  The meaning of all those
		cells is defined by the binding for the phy node. The PHY
		provider can use the values in cells to find the appropriate
		PHY.

For example:

phys: phy {
    compatible = "xxx";
    reg = <...>;
    .
    .
    #phy-cells = <1>;
    .
    .
};

That node describes an IP block (PHY provider) that implements 2 different PHYs.
In order to differentiate between these 2 PHYs, an additonal specifier should be
given while trying to get a reference to it.

PHY user node
=============

Required Properties:
phys : the phandle for the PHY device (used by the PHY subsystem)
phy-names : the names of the PHY corresponding to the PHYs present in the
	    *phys* phandle

Example 1:
usb1: usb_otg_ss@xxx {
    compatible = "xxx";
    reg = <xxx>;
    .
    .
    phys = <&usb2_phy>, <&usb3_phy>;
    phy-names = "usb2phy", "usb3phy";
    .
    .
};

This node represents a controller that uses two PHYs, one for usb2 and one for
usb3.

Example 2:
usb2: usb_otg_ss@xxx {
    compatible = "xxx";
    reg = <xxx>;
    .
    .
    phys = <&phys 1>;
    phy-names = "usbphy";
    .
    .
};

This node represents a controller that uses one of the PHYs of the PHY provider
device defined previously. Note that the phy handle has an additional specifier
"1" to differentiate between the two PHYs.

AQ-PHY user node
================

Required Properties:
phy-addr: phy_addr of the phy which will use Aquantia
mdiobus: mdio bus name#number on which the phy is located.

Example:
aq-phy {
	compatible = "qcom,aq-phy";
	qcom,phy-addr = <0x10>;
	mdiobus = <&mdio1>;
};

85XX_MUSIC_SWITCH node
=====================

Required Properties:
sgmii-plus-if-phy-addr: phy addr of the AQ-PHY
chip-id:
	1 -> 8511 chip
	2 -> 8512 chip
	3 -> 8513 chip
	4 -> 8519 chip
qsgmii-cfg-port-mode: GMAC port modes. set 1 for QSGMII
qsgmii-cfg-port-base: 85xx Switch GMAC port ID
qsgmii-cfg-is-speed-forced: GMAC forced speed enable/disable
qsgmii-cfg-forced-speed: GMAC forced speed
qsgmii-cfg-forced-duplex: GMAC mode.
port-26-cfg-port-mode: port 26 is for 8033 phy configuration
port-26-cfg-is-speed-forced: GMAC forced speed
port-27-cfg-port-mode: port 27 is for AQ-PHY configuration
port-27-cfg-is-speed-forced: GMAC forced speed enable/disable
port-27-cfg-forced-speed: GMAC forced speed
port-27-cfg-forced-duplex: GMAC mode.
trunk-cfg-is-trunk-enabled: LAG enable/disable on switch
trunk-cfg-trunk-id: LAG mode
trunk-cfg-trunk-hash-policy: LAG policy
trunk-cfg-trunk-ports-bit-map: LAG bitmap
mdiobus: mdiobus for the 8033 PHY
sgmii-plus-if-phy-mdiobus: mdiobus for AQ-PHY

Example:
qca-85xx-sw {
	compatible = "qcom,qca-85xx-sw";
	qcom,sgmii-plus-if-phy-addr = <0x10>;
	qcom,chip-id = <1>;
	qcom,qsgmii-cfg-port-mode = <1>;
	qcom,qsgmii-cfg-port-base = <1>;
	qcom,qsgmii-cfg-is-speed-forced = <1>;
	qcom,qsgmii-cfg-forced-speed = <1000>;
	qcom,qsgmii-cfg-forced-duplex = <1>;
	qcom,port-26-cfg-port-mode = <2>;
	qcom,port-26-cfg-is-speed-forced = <0>;
	qcom,port-27-cfg-port-mode = <3>;
	qcom,port-27-cfg-is-speed-forced = <1>;
	qcom,port-27-cfg-forced-speed = <2500>;
	qcom,port-27-cfg-forced-duplex = <1>;
	qcom,trunk-cfg-is-trunk-enabled = <1>;
	qcom,trunk-cfg-trunk-id = <0>;
	qcom,trunk-cfg-trunk-hash-policy = <0x6c>;
	qcom,trunk-cfg-trunk-ports-bit-map = <0x1c>;
	mdiobus = <&mdio0>;
	sgmii-plus-if-phy-mdiobus = <&mdio1>;
};
```

## release/src-qca-dakota/linux/linux-3.14.x/Documentation/devicetree/bindings/pinctrl/qcom,ipq40xx-pinctrl.txt
```
Qualcomm Atheros IPQ40xx TLMM block

Required properties:
- compatible: "qcom,ipq40xx-pinctrl"
- reg: Should be the base address and length of the TLMM block.
- interrupts: Should be the parent IRQ of the TLMM block.
- interrupt-controller: Marks the device node as an interrupt controller.
- #interrupt-cells: Should be two.
- gpio-controller: Marks the device node as a GPIO controller.
- #gpio-cells : Should be two.
                The first cell is the gpio pin number and the
                second cell is used for optional parameters.

Please refer to ../gpio/gpio.txt and ../interrupt-controller/interrupts.txt for
a general description of GPIO and interrupt bindings.

Please refer to pinctrl-bindings.txt in this directory for details of the
common pinctrl bindings used by client devices, including the meaning of the
phrase "pin configuration node".

The pin configuration nodes act as a container for an abitrary number of
subnodes. Each of these subnodes represents some desired configuration for a
pin, a group, or a list of pins or groups. This configuration can include the
mux function to select on those pin(s)/group(s), and various pin configuration
parameters, such as pull-up, drive strength, etc.

The name of each subnode is not important; all subnodes should be enumerated
and processed purely based on their content.

Each subnode only affects those parameters that are explicitly listed. In
other words, a subnode that lists a mux function but no pin configuration
parameters implies no information about any pin configuration parameters.
Similarly, a pin subnode that describes a pullup parameter implies no
information about e.g. the mux function.


The following generic properties as defined in pinctrl-bindings.txt are valid
to specify in a pin configuration subnode:
 pins, function, bias-disable, bias-pull-down, bias-pull,up, drive-strength.

Non-empty subnodes must specify the 'pins' property.
Note that not all properties are valid for all pins.


Valid values for qcom,pins are:
  gpio0-gpio70
    Supports mux, bias and drive-strength

    sdio_cd, sdio_clk, sdio_cmd, sdio_data1, sdio_data1, sdio_data1, sdio_data1,
    sdio_data5, sdio_data6, sdio_data7

Valid values for qcom,function are:
smart0, jtag, audio0, mdio0, wcss0_dbg18, wcss1_dbg18, qdss_tracedata_a, mdc,
wcss0_dbg19, wcss1_dbg19, blsp_uart1, wifi0_uart, wifi1_uart, smart1,
wcss0_dbg20, wcss1_dbg20, wifi0_uart0, wifi1_uart0, wcss0_dbg21, wcss1_dbg21,
blsp_i2c0, wcss0_dbg22, wcss1_dbg22, wcss0_dbg23, wcss1_dbg23, blsp_i2c1,
wcss0_dbg24, wcss1_dbg24, wcss0_dbg25, wcss1_dbg25, pcie_rst, wcss0_dbg26,
wcss1_dbg26, pcie_clk0, wcss0_dbg27, wcss1_dbg27, led0, blsp_uart0, led1,
chip_irq0, wifi0_uart1, wifi1_uart1, wcss0_dbg28, wcss1_dbg28, chip_rst,
audio_spdifout, sdio1, rgmii2, sdio2, rgmii3, sdio3, rgmii_rx, sdio_clk,
wcss0_dbg29, wcss1_dbg29, wcss0_dbg16, wcss1_dbg16, audio1, wcss0_dbg17,
wcss1_dbg17, sdio_cd, rgmii0, sdio0, rgmii1, rgmii_txc, audio_td1, sdio_cmd,
audio_td2, sdio4, audio_td3, sdio5, audio_pwm0, sdio6, audio_pwm1, sdio7,
rgmii_rxc, audio_pwm2, rgmii_tx, audio_pwm3, wcss0_dbg30, wcss1_dbg30,
wcss0_dbg31, wcss1_dbg31, rmii00, led2, rmii01, wifi0_wci, wifi1_wci,
rmii0_tx, rmii0_rx, pcie_clk1, led3, pcie_wakeup, rmii0_refclk,
wifi0_rfsilient0, wifi1_rfsilient0, smart2, led4, wifi0_cal, wifi1_cal,
wifi_wci0, rmii0_dv, wifi_wci1, rmii1_refclk, blsp_spi1, led5, rmii10,
blsp_spi0, led6, rmii11, led7, rmii1_dv, led8, rmii1_tx, aud_pin, led9,
rmii1_rx, led10, wifi0_rfsilient1, wifi1_rfsilient1, led11, qpic_pad,
qdss_cti_trig_in_a0, mdio1, audio2, dbg_out, wcss0_dbg, wcss1_dbg, atest_char3,
pmu0, wcss0_dbg0, wcss1_dbg0, atest_char2, pmu1, wcss0_dbg1, wcss1_dbg1,
atest_char1, wcss0_dbg2, wcss1_dbg2, qpic_pad4, atest_char0, wcss0_dbg3,
wcss1_dbg3, qpic_pad5, smart3, wcss0_dbg14, wcss1_dbg14, qpic_pad6,
wcss0_dbg15, wcss1_dbg15, qdss_tracectl_a, qpic_pad7, atest_char, wcss0_dbg4,
wcss1_dbg4, qdss_traceclk_a, qpic_pad8, wcss0_dbg5, wcss1_dbg5,
qdss_cti_trig_out_a0, wcss0_dbg6, wcss1_dbg6, qdss_cti_trig_out_b0, chip_irq1,
qpic_pad0, wcss0_dbg7, wcss1_dbg7, qdss_cti_trig_in_b0, qpic_pad1, wcss0_dbg8,
wcss1_dbg8, qpic_pad2, wcss0_dbg9, wcss1_dbg9, qpic_pad3, wcss0_dbg10,
wcss1_dbg10, wcss0_dbg11, wcss1_dbg11, wcss0_dbg12, wcss1_dbg12, wcss0_dbg13,
wcss1_dbg13

Example:

	msmgpio: pinctrl@1000000 {
		compatible = "qcom,ipq40xx-pinctrl";
		reg = <0x1000000 0x300000>;

		gpio-controller;
		#gpio-cells = <2>;
		interrupt-controller;
		#interrupt-cells = <2>;
		interrupts = <0 208 0>;

		pinctrl-names = "default";
		pinctrl-0 = <&blsp_uart1>;

		blsp_uart1_default: blsp_uart1_default {
			mux {
				qcom,pins = "gpio4", "gpio5";
				qcom,function = "blsp_uart1";
			};

			tx {
				qcom,pins = "gpio4";
				drive-strength = <4>;
				bias-disable;
			};

			rx {
				qcom,pins = "gpio5";
				drive-strength = <2>;
				bias-pull-up;
			};
		};
	};
```

## release/src-qca-dakota/linux/linux-3.14.x/Documentation/devicetree/bindings/qca/soc.txt
```
QCA System-on-Chip

Required properties:

- compatible: "simple-bus"
- #address-cells: must be 1
- #size-cells: must be 1

Example:

	soc {
		compatible = "simple-bus";
		model = "Qualcomm Technologies, Inc. IPQ40xx";
		#address-cells = <1>;
		#size-cells = <1>;
		...
	};
```

## release/src-qca-dakota/linux/linux-3.14.x/Documentation/devicetree/bindings/qca/wlan.txt
```
QCA WLAN Driver
---------------

This driver adds support for the WLAN subsystem for supporting
integrated WLAN module

Required properties:
  - compatible = "qca,wifi-ipq40xx";
  - reg = <baseaddr length>
  - resets = <list of wifi resets>.
  - reset-names = <list of reset's string name defined in the resets field>.
  - interrupts = <list of msi and legacy interrupts>
  - interrupt-names = <list of interrupt's string name defined in the interrupts field. Please
    ensure the order of the interrupts and the interrupts name matches with each other.
  - status = ok or disabled.
  - qca,msi_addr = <msiaddr>
  - qca,msi_base = <msidata>
    Please refer below example.


Optional properties:

Example:

	wifi0: wifi@a000000 {
	   compatible = "qca,wifi-qca961x";
	   reg = <0xa000000 0x200000>;
	   resets = <&gcc WIFI0_CPU_INIT_RESET>,
		  <&gcc WIFI0_RADIO_SRIF_RESET>,
		  <&gcc WIFI0_RADIO_WARM_RESET>,
		  <&gcc WIFI0_RADIO_COLD_RESET>,
		  <&gcc WIFI0_CORE_WARM_RESET>,
		  <&gcc WIFI0_CORE_COLD_RESET>;
	   reset-names = "wifi_cpu_init",
	       "wifi_radio_srif",
	       "wifi_radio_warm",
	       "wifi_radio_cold",
	       "wifi_core_warm",
	       "wifi_core_cold";
	   /* TBD: Check if 'clocks' entry is required here - if required, add the entries once they are defined in GCC driver */
	   interrupts = <0 0x20 0x1>,
		      <0 0x21 0x1>,
		      <0 0x22 0x1>,
		      <0 0x23 0x1>,
		      <0 0x24 0x1>,
		      <0 0x25 0x1>,
		      <0 0x26 0x1>,
		      <0 0x27 0x1>,
		      <0 0x28 0x1>,
		      <0 0x29 0x1>,
		      <0 0x2a 0x1>,
		      <0 0x2b 0x1>,
		      <0 0x2c 0x1>,
		      <0 0x2d 0x1>,
		      <0 0x2e 0x1>,
		      <0 0x2f 0x1>,
		      <0 0xa8 0x0>;
	   interrupt-names = "msi0", "msi1", "msi2", "msi3", "msi4", "msi5", "msi6",
	       "msi7", "msi8", "msi9", "msi10", "msi11", "msi12", "msi13", "msi14",
	       "msi15", "legacy";
	   status = "disabled";
	   qca,msi_addr = <0x0b006040>;
	   qca,msi_base = <0x40>;
       };`
```

## release/src-qca-dakota/linux/linux-3.14.x/Documentation/devicetree/bindings/sound/qca,ipq40xx-audio-spdifin.txt
```
qca,ipq40xx-audio-spdifin

SPDIFIN configuration space for IPQ40xx

Required properties:

  - compatible : "qca,ipq40xx-audio-spdifin"

  - reg	: Must contain SPDIF core's registers location and length

Example:

spdifin: spdifin@7707000 {
	compatible = "qca,ipq40xx-audio-spdifin";
	reg = <0x7707000 0x20>;
};
```

## release/src-qca-dakota/linux/linux-3.14.x/Documentation/devicetree/bindings/sound/qca,ipq40xx-codec.txt
```
QCA CODEC Module

Required properties:
- compatible : "qca,ipq40xx-codec"
- reg : Chip Address of the codec

Example:

qca_codec: qca_codec@10 {
	compatible = "qca,ipq40xx-codec";
	reg = <0x10>;
};
```

## release/src-qca-dakota/linux/linux-3.14.x/Documentation/devicetree/bindings/sound/qca,ipq40xx-i2s1.txt
```
QCA I2S1 DAI module

Required properties:
- compatible : "qca,ipq40xx-i2s1"
- dma-tx-channel : Specify the MBOX TX channel number for I2S1.
- stereo-tx-port : Specify the Stereo port id for I2S1.

Example:

i2s1: ipq40xx-pcm-i2s1@0 {
	compatible = "qca,ipq40xx-i2s1";
	dma-tx-channel = <MBOX1_TX_ID>;
	stereo-tx-port = <STEREO1_ID>;
};
```

## release/src-qca-dakota/linux/linux-3.14.x/Documentation/devicetree/bindings/sound/qca,ipq40xx-i2s2.txt
```
QCA I2S2 DAI module

Required properties:
- compatible : "qca,ipq40xx-i2s2"
- dma-tx-channel : Specify the MBOX TX channel number for I2S2.
- stereo-tx-port : Specify the Stereo port id for I2S2.

Example:

i2s2: ipq40xx-pcm-i2s2@0 {
	compatible = "qca,ipq40xx-i2s2";
	dma-tx-channel = <MBOX2_TX_ID>;
	stereo-tx-port = <STEREO2_ID>;
};
```

## release/src-qca-dakota/linux/linux-3.14.x/Documentation/devicetree/bindings/sound/qca,ipq40xx-pcm-i2s1.txt
```
QCA I2S1 platform module

Required properties:
- compatible : "qca,ipq40xx-pcm-i2s1"
- reg : Physical base address and length of the device's registers.

Example:

i2s1platform: qca-pcm-i2s1@770b000 {
	compatible = "qca,ipq40xx-pcm-i2s1";
	reg = <0x770b000 0x1000>;
};
```

## release/src-qca-dakota/linux/linux-3.14.x/Documentation/devicetree/bindings/sound/qca,ipq40xx-pcm-i2s2.txt
```
QCA I2S2 platform module

Required properties:
- compatible : "qca,ipq40xx-pcm-i2s2"
- reg : Physical base address and length of the device's registers.

Example:

i2s2platform: qca-pcm-i2s2@770d000 {
	compatible = "qca,ipq40xx-pcm-i2s1";
	reg = <0x770d000 0x1000>;
};
```

## release/src-qca-dakota/linux/linux-3.14.x/Documentation/devicetree/bindings/sound/qca,ipq40xx-pcm-lb.txt
```
qca,ipq40xx-pcm-lb

VOIP PCM driver loopback test module for IPQ40xx

Required properties:

  - compatible : "qca,ipq40xx-pcm-lb"

Example:

pcm_lb: pcm_lb@0 {
        compatible = "qca,ipq40xx-pcm-lb";
};
```

## release/src-qca-dakota/linux/linux-3.14.x/Documentation/devicetree/bindings/sound/qca,ipq40xx-pcm-spdif.txt
```
qca,ipq40xx-pcm-spdif

SPDIF platform driver for IPQ40xx

Required properties:

  - compatible : "qca,ipq40xx-pcm-spdif"
  - reg : <0x7707000 0x1000>
  - status: disabled/ok

Example:

spdifplatform: qca-pcm-spdif@7707000 {
	compatible = "qca,ipq40xx-pcm-spdif";
	reg = <0x7707000 0x1000>;
	status = "disabled";
};
```

## release/src-qca-dakota/linux/linux-3.14.x/Documentation/devicetree/bindings/thermal/msm-thermal.txt
```
* MSM Kernel Thermal Mitigation (KTM)

Required properties:
- compatible : "qcom,msm-thermal"
- qcom,sensor-id : Temperature sensor ID to poll.
- qcom,poll-ms : Poll interval in milliseconds.
- qcom,limit-temp : Threshold temperature for mitigation
		to kick in.
- qcom,temp-hysteresis : Difference in temperature required
		to stop mitigation after threshold is hit.
- qcom,freq-step : No.of steps to skip to get to lower or
		higher frequencies in the frequency table.
- qcom,core-limit-temp : Threshold temperature to disable cores.
- qcom,core-temp-hysteresis : Difference in temperature required
		to enable the core back once it is shut down.
- qcom,core-control-mask : Core control mask value.

Example:

qcom,msm-thermal {
	compatible = "qcom,msm-thermal";
	qcom,sensor-id = <0>;
	qcom,poll-ms = <250>;
	qcom,limit-temp = <105>;
	qcom,temp-hysteresis = <10>;
	qcom,freq-step = <2>;
	qcom,core-limit-temp = <115>;
	qcom,core-temp-hysteresis = <10>;
	qcom,core-control-mask = <0xe>;
};
~
```
