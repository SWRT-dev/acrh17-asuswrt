## release/src-qca-dakota/linux/linux-3.14.x/Documentation/devicetree/bindings/arm/ipq.txt
```
QCA IPQ device tree bindings
---------------------------------

System on Chip

Device tree must specify which SoC it uses, with one of the
following compatible strings

	"qcom,qca961x"
	"qcom,ipq8064"
	"qcom,ipq8062"
	"qcom,ipq40xx"
Platform

Device tree must specify which Platform it uses, with one of the
following compatible strings

	"qcom,qca961x-r3pc"
	"qcom,ipq40xx-apdk01.1"
	"qcom,ipq40xx-apdk04.1"
	"qcom,ipq8062-ap145"
	"qcom,ipq8064-ap161"
	"qcom,ipq8064-ap160"
	"qcom,ipq8064-ap160_2xx"
	"qcom,ipq8064-ak01"
```

## release/src-qca-dakota/linux/linux-3.14.x/Documentation/devicetree/bindings/clock/qca,gcnt.txt
```
QCA Global Counter
------------------------------------------------

Required properties :
- compatible : "qcom,qca-gcnt"

- reg : shall contain base register location and length

Example:

	counter {
		compatible = "qcom,qca-gcnt";
		reg = <0x004a1000 0x4>;
	};
```

## release/src-qca-dakota/linux/linux-3.14.x/Documentation/devicetree/bindings/clock/qcom,nss-common.txt
```
Qualcomm Atheros Inc NSS voltage scaling
------------------------------------------------

Required properties :
- compatible : "qcom,nss-common"
- reg : shall contain base register location
- reg-names  : shall contain register name
- clocks : defines each clock
- clock-names : contains clock names
- nss_core-supply : regulator supply
- nss_core_vdd_nominal : nominal voltage level
- nss_core_vdd_high : high voltage level
- nss_core_threshold_freq : threshold freq for high voltage

Example:

	nss-common {
		compatible = "qcom,nss-common";
		reg = <0x03000000 0x00001000>;
		reg-names = "nss_fpb_base";
		clocks = <&gcc NSS_CORE_CLK>, <&gcc NSSTCM_CLK>, <&nss_fabric0_clk>, <&nss_fabric1_clk>;
		clock-names = "nss-core-clk", "nss-tcm-clk", "nss-fab0-clk", "nss-fab0-clk";
		nss_core-supply = <&smb208_s1b>;
		nss_core_vdd_nominal = <1100000>;
		nss_core_vdd_high = <1150000>;
		nss_core_threshold_freq = <733000000>;
	};
```

## release/src-qca-dakota/linux/linux-3.14.x/Documentation/devicetree/bindings/cpufreq/cpufreq-qca.txt
```
qca,ipq40xx cpufreq driver
-------------------

IPQ40xx SoC cpufreq driver for CPU frequency scaling.

Required properties:
- operating-points: Table of frequencies and voltage CPU could be transitioned into,
	in the decreasing order. Frequency should be in KHz units and voltage
	should be in microvolts.

Optional properties:
- clock-latency: Clock monitor latency in microsecond. Example: 200usec

All the required listed above must be defined under node cpufreq.

Example:
--------
	cpu_freq_ipq40xx {
		compatible = "qca,ipq40xx_freq";
		clock-latency = <0x100>;
	};
```

## release/src-qca-dakota/linux/linux-3.14.x/Documentation/devicetree/bindings/mfd/qcom-rpm.txt
```
Qualcomm Resource Power Manager (RPM)

This driver is used to interface with the Resource Power Manager (RPM) found in
various Qualcomm platforms. The RPM allows each component in the system to vote
for state of the system resources, such as clocks, regulators and bus
frequencies.

- compatible:
	Usage: required
	Value type: <string>
	Definition: must be one of:
		    "qcom,rpm-apq8064"
		    "qcom,rpm-msm8660"
		    "qcom,rpm-msm8960"
		    "qcom,rpm-ipq8064"

- reg:
	Usage: required
	Value type: <prop-encoded-array>
	Definition: base address and size of the RPM's message ram

- interrupts:
	Usage: required
	Value type: <prop-encoded-array>
	Definition: three entries specifying the RPM's:
		    1. acknowledgement interrupt
		    2. error interrupt
		    3. wakeup interrupt

- interrupt-names:
	Usage: required
	Value type: <string-array>
	Definition: must be the three strings "ack", "err" and "wakeup", in order

- #address-cells:
	Usage: required
	Value type: <u32>
	Definition: must be 1

- #size-cells:
	Usage: required
	Value type: <u32>
	Definition: must be 0

- qcom,ipc:
	Usage: required
	Value type: <prop-encoded-array>

	Definition: three entries specifying the outgoing ipc bit used for
		    signaling the RPM:
		    - phandle to a syscon node representing the apcs registers
		    - u32 representing offset to the register within the syscon
		    - u32 representing the ipc bit within the register


= SUBDEVICES

The RPM exposes resources to its subnodes. The below bindings specify the set
of valid subnodes that can operate on these resources.

== Switch-mode Power Supply regulator

- compatible:
	Usage: required
	Value type: <string>
	Definition: must be one of:
		    "qcom,rpm-pm8058-smps"
		    "qcom,rpm-pm8901-ftsmps"
		    "qcom,rpm-pm8921-smps"
		    "qcom,rpm-pm8921-ftsmps"

- reg:
	Usage: required
	Value type: <u32>
	Definition: resource as defined in <dt-bindings/mfd/qcom-rpm.h>
		    must be one of:
		    QCOM_RPM_PM8058_SMPS0 - QCOM_RPM_PM8058_SMPS4,
		    QCOM_RPM_PM8821_SMPS1 - QCOM_RPM_PM8821_SMPS2,
		    QCOM_RPM_PM8901_SMPS0 - QCOM_RPM_PM8901_SMPS4,
		    QCOM_RPM_PM8921_SMPS1 - QCOM_RPM_PM8921_SMPS8

- bias-pull-down:
	Usage: optional
	Value type: <empty>
	Definition: enable pull down of the regulator when inactive

- qcom,switch-mode-frequency:
	Usage: required
	Value type: <u32>
	Definition: Frequency (Hz) of the switch-mode power supply;
		    must be one of:
		    19200000, 9600000, 6400000, 4800000, 3840000, 3200000,
		    2740000, 2400000, 2130000, 1920000, 1750000, 1600000,
		    1480000, 1370000, 1280000, 1200000

- qcom,force-mode:
	Usage: optional (default if no other qcom,force-mode is specified)
	Value type: <u32>
	Defintion: indicates that the regulator should be forced to a
		   particular mode, valid values are:
		   QCOM_RPM_FORCE_MODE_NONE - do not force any mode
		   QCOM_RPM_FORCE_MODE_LPM - force into low power mode
		   QCOM_RPM_FORCE_MODE_HPM - force into high power mode
		   QCOM_RPM_FORCE_MODE_AUTO - allow regulator to automatically
					      select its own mode based on
					      realtime current draw, only for:
					      qcom,rpm-pm8921-smps,
					      qcom,rpm-pm8921-ftsmps

- qcom,power-mode-hysteretic:
	Usage: optional
	Value type: <empty>
	Definition: select that the power supply should operate in hysteretic
		    mode, instead of the default pwm mode

Standard regulator bindings are used inside switch mode power supply subnodes.
Check Documentation/devicetree/bindings/regulator/regulator.txt for more
details.

== Low-dropout regulator

- compatible:
	Usage: required
	Value type: <string>
	Definition: must be one of:
		    "qcom,rpm-pm8058-pldo"
		    "qcom,rpm-pm8058-nldo"
		    "qcom,rpm-pm8901-pldo"
		    "qcom,rpm-pm8901-nldo"
		    "qcom,rpm-pm8921-pldo"
		    "qcom,rpm-pm8921-nldo"
		    "qcom,rpm-pm8921-nldo1200"

- reg:
	Usage: required
	Value type: <u32>
	Definition: resource as defined in <dt-bindings/mfd/qcom-rpm.h>
		    must be one of:
		    QCOM_RPM_PM8058_LDO0 - QCOM_RPM_PM8058_LDO25,
		    QCOM_RPM_PM8821_LDO1,
		    QCOM_RPM_PM8901_LDO0 - QCOM_RPM_PM8901_LDO6,
		    QCOM_RPM_PM8921_LDO1 - QCOM_RPM_PM8921_LDO29

- bias-pull-down:
	Usage: optional
	Value type: <empty>
	Definition: enable pull down of the regulator when inactive

- qcom,force-mode:
	Usage: optional
	Value type: <u32>
	Defintion: indicates that the regulator should not be forced to any
		   particular mode, valid values are:
		   QCOM_RPM_FORCE_MODE_NONE - do not force any mode
		   QCOM_RPM_FORCE_MODE_LPM - force into low power mode
		   QCOM_RPM_FORCE_MODE_HPM - force into high power mode
		   QCOM_RPM_FORCE_MODE_BYPASS - set regulator to use bypass
						mode, i.e.  to act as a switch
						and not regulate, only for:
						qcom,rpm-pm8921-pldo,
						qcom,rpm-pm8921-nldo,
						qcom,rpm-pm8921-nldo1200

Standard regulator bindings are used inside switch low-dropout regulator
subnodes.  Check Documentation/devicetree/bindings/regulator/regulator.txt for
more details.

== Negative Charge Pump

- compatible:
	Usage: required
	Value type: <string>
	Definition: must be one of:
		    "qcom,rpm-pm8058-ncp"
		    "qcom,rpm-pm8921-ncp"

- reg:
	Usage: required
	Value type: <u32>
	Definition: resource as defined in <dt-bindings/mfd/qcom-rpm.h>
		    must be one of:
		    QCOM_RPM_PM8058_NCP,
		    QCOM_RPM_PM8921_NCP

- qcom,switch-mode-frequency:
	Usage: required
	Value type: <u32>
	Definition: Frequency (Hz) of the swith mode power supply;
		    must be one of:
		    19200000, 9600000, 6400000, 4800000, 3840000, 3200000,
		    2740000, 2400000, 2130000, 1920000, 1750000, 1600000,
		    1480000, 1370000, 1280000, 1200000

Standard regulator bindings are used inside negative charge pump regulator
subnodes.  Check Documentation/devicetree/bindings/regulator/regulator.txt for
more details.

== Switch

- compatible:
	Usage: required
	Value type: <string>
	Definition: must be one of:
		    "qcom,rpm-pm8058-switch"
		    "qcom,rpm-pm8901-switch"
		    "qcom,rpm-pm8921-switch"

- reg:
	Usage: required
	Value type: <u32>
	Definition: resource as defined in <dt-bindings/mfd/qcom/qcom-rpm.h>
		    must be one of:
		    QCOM_RPM_PM8058_LVS0 - QCOM_RPM_PM8058_LVS1,
		    QCOM_RPM_PM8901_LVS0 - QCOM_RPM_PM8901_LVS3,
		    QCOM_RPM_PM8901_MVS,
		    QCOM_RPM_PM8921_LVS1 - QCOM_RPM_PM8921_LVS7,
		    QCOM_RPM_PM8921_MVS

= EXAMPLE

	#include <dt-bindings/mfd/qcom-rpm.h>

	rpm@108000 {
		compatible = "qcom,rpm-msm8960";
		reg = <0x108000 0x1000>;
		qcom,ipc = <&apcs 0x8 2>;

		interrupts = <0 19 0>, <0 21 0>, <0 22 0>;
		interrupt-names = "ack", "err", "wakeup";

		#address-cells = <1>;
		#size-cells = <0>;

		pm8921_smps1: pm8921-smps1 {
			compatible = "qcom,rpm-pm8921-smps";
			reg = <QCOM_RPM_PM8921_SMPS1>;

			regulator-min-microvolt = <1225000>;
			regulator-max-microvolt = <1225000>;
			regulator-always-on;

			bias-pull-down;

			qcom,switch-mode-frequency = <3200000>;
		};
	};
```

## release/src-qca-dakota/linux/linux-3.14.x/Documentation/devicetree/bindings/net/qcom-nss-drv.txt
```
* Qualcomm Technologies Inc. NSS HLOS Platform Driver.

This driver communicates with the NSS Firmware, and provides empty buffers for packet-processing to the UBI32 processor.
It also keeps track of sync packets from NSS Firmware.
This driver has 2 sections listed below, one common to all the UBI32 cores and other specific to each UBI32 core.

1. Driver access details specific to each UBI32/NSS core.

Required properties:
- compatible: "qcom,nss0"
- compatible: "qcom,nss1"
- interrupts: UBI32 to Apps interrupts for Sync/Data Packets and Empty Buffers.
- reg-names: Indicates various resources passed to driver by name.
		"nphys","vphys"
		Refers to TCM and CSM Base Addresses of UBI32 Memory map.
- reg: physical address and length of the register set for the device.
- qcom,id: Unique Identifier for the HLOS block.This field is unique identifier for the core, which is also used as an index for global nss context.
- clocks: physical address for NSS source clock, TCM clock and fabric clock.
- resets: physical address for core clock reset, AHB and AXI reset.
- qcom,rst_addr: Reset vector for NSS core.
- qcom,load_addr: physical address to load NSS firmware.
- qcom,turbo_frequency = turbo freq supported or not.
- qcom,low_frequency = lowest supported operating frequency.
- qcom,mid_frequency = nominal supported operating frequency.
- qcom,max_frequency = maximum supported operating frequency.

Optional properties:
- qcom,ipv4-enabled: Enables registeration of N2H/PPPoE/ETH handlers, to receive stat sync
	             IPV4 packets from UBI32.
- qcom,ipv6-enabled: Enables registeration of IPV6 packet handlers, to receive stat sync
                     IPV6 packets from UBI32.
- qcom,crypto-enabled: Enables the cryptography feature for the platform.
- qcom,gmac0-enabled: Enables GMAC0 port.
- qcom,gmac1-enabled: Enables GMAC1 port.
- qcom,gmac2-enabled: Enables GMAC2 port.
- qcom,gmac3-enabled: Enables GMAC3 port.
- qcom,wlan_dataplane_offload_enabled: Enables wifi dataplane offload in NSS.

example:
nss0: nss@40000000 {
	compatible = "qcom,nss0";
	pinctrl-0 = <&nss_spi_pins>;
	pinctrl-names = "default";
	interrupts = <GIC_SPI 213 IRQ_TYPE_LEVEL_HIGH
		GIC_SPI 232 IRQ_TYPE_LEVEL_HIGH>;
	reg = <0x36000000 0x1000 0x39000000 0x10000>;
	reg-names = "nphys", "vphys";
	clocks = <&gcc NSS_CORE_CLK>, <&gcc NSSTCM_CLK_SRC>, <&gcc NSSTCM_CLK>, <&nss_fabric0_clk>, <&nss_fabric1_clk>;
	clock-names = "nss_core_clk", "nss_tcm_src", "nss_tcm_clk", "nss-fab0-clk", "nss-fab1-clk";
	resets = <&gcc UBI32_CORE1_CLKRST_CLAMP_RESET>,
		<&gcc UBI32_CORE1_CLAMP_RESET>,
		<&gcc UBI32_CORE1_AHB_RESET>,
		<&gcc UBI32_CORE1_AXI_RESET>;
	reset-names = "clkrst_clamp", "clamp", "ahb", "axi";
	qcom,id = <0>;
	qcom,num_irq = <2>;
	qcom,rst_addr = <0x40000000>;
	qcom,load_addr = <0x40000000>;
	qcom,turbo_frequency = <1>;
	qcom,low_frequency = <110000000>;
	qcom,mid_frequency = <550000000>;
	qcom,max_frequency = <733000000>;
	qcom,ipv4_enabled = <1>;
	qcom,ipv6_enabled = <1>;
	qcom,l2switch_enabled = <1>;
	qcom,crypto_enabled = <0>;
	qcom,ipsec_enabled = <0>;
	qcom,wlanredirect_enabled = <1>;
	qcom,tun6rd_enabled = <1>;
	qcom,tunipip6_enabled = <1>;
	qcom,shaping_enabled = <1>;
	qcom,gmac0_enabled = <1>;
	qcom,gmac1_enabled = <1>;
	qcom,gmac2_enabled = <1>;
	qcom,gmac3_enabled = <1>;
	qcom,wlan_dataplane_offload_enabled = <1>;
};

nss1: nss@40800000 {
	compatible = "qcom,nss1";
	interrupts = <GIC_SPI 214 IRQ_TYPE_LEVEL_HIGH
			  GIC_SPI 233 IRQ_TYPE_LEVEL_HIGH>;
	reg = <0x36400000 0x1000 0x39010000 0x10000>;
	reg-names = "nphys", "vphys";
	resets = <&gcc UBI32_CORE2_CLKRST_CLAMP_RESET>,
		 <&gcc UBI32_CORE2_CLAMP_RESET>,
		 <&gcc UBI32_CORE2_AHB_RESET>,
		 <&gcc UBI32_CORE2_AXI_RESET>;
	reset-names = "clkrst_clamp", "clamp", "ahb", "axi";
	qcom,id = <1>;
	qcom,num_irq = <2>;
	qcom,rst_addr = <0x40800000>;
	qcom,load_addr = <0x40800000>;
	qcom,turbo_frequency = <1>;
	qcom,low_frequency = <110000000>;
	qcom,mid_frequency = <550000000>;
	qcom,max_frequency = <733000000>;
	qcom,ipv4_enabled = <0>;
	qcom,ipv6_enabled = <0>;
	qcom,l2switch_enabled = <0>;
	qcom,crypto_enabled = <1>;
	qcom,ipsec_enabled = <1>;
	qcom,wlanredirect_enabled = <0>;
	qcom,tun6rd_enabled = <0>;
	qcom,tunipip6_enabled = <0>;
	qcom,shaping_enabled = <0>;
	qcom,gmac0_enabled = <0>;
	qcom,gmac1_enabled = <0>;
	qcom,gmac2_enabled = <0>;
	qcom,gmac3_enabled = <0>;
	qcom,wlan_dataplane_offload_enabled = <0>;
};
```

## release/src-qca-dakota/linux/linux-3.14.x/Documentation/devicetree/bindings/net/qcom-nss-macsec.txt
```
* Qualcomm Technologies Inc. NSS MAC Security Engine Driver.

This driver configures GMAC Security Engine on the board.

1. Driver access details to each GMAC Security Engine

Required properties:
- device_type: = "network";
- compatible: = should be "qcom,nss-macsec";
- reg:  physical address and length of the register set for the device.

Optional properties:

Example:
nss-macsec0@37800000{
	compatible = "qcom,nss-macsec";
	reg = <0x37800000 0x00200000>;
};
```
