## release/src-qca-dakota/linux/linux-3.14.x/Documentation/devicetree/bindings/thermal/qcom-thermal.txt
```
* QCOM SoC Temperature Sensor (TSENS)

Required properties:
- compatible : "qcom,ipq806x-tsens"
- qcom,slope : Must contain slope value for each of the sensors controlled
			by this device
- reg : Registers and the corresponding size which needs to
	be ioremapped.
- reg-names = Names for each registers.
- interrupts : Notification interrupt to the userspace.
- qcom,tsens_factor : Sensor multiplication factor.
- qcom,sensors : No.of sensors available.

Example:

tsens: tsens-ipq806x {
	compatible = "qcom,ipq806x-tsens";
	reg = <0x900000 0x3678>, <0x700000 0x420>;
	reg-names = "tsens_physical", "tsens_eeprom_physical";
	interrupts = <0 178 0>;
	qcom,sensors = <11>;
	qcom,tsens_factor = <1000>;
	qcom,slope = <1176 1176 1154 1176 1111 1132 1132 1199 1132 1199 1132>;
};
```

## release/src-qca-dakota/linux/linux-3.14.x/Documentation/devicetree/bindings/usb/qca,dwc3.txt
```
Qualcomm Atheros SuperSpeed DWC3 USB SoC controller


QCA BALDUR Highspeed USB PHY
========================
Required properities:
- compatible:	should contain "qca,baldur-usb3-hsphy" or "qca,baldur-usb2-hsphy"
- reg:			offset and length of the register set in the memory map
- clocks:		A list of phandle + clock-specifier pairs for the
				clocks listed in clock-names
- clock-names:	Should contain the following:


QCA UNI Superspeed USB PHY
=========================
Required properities:
- compatible:	should contain "qca,uni-ssphy";
- reg:			offset and length of the register set in the memory map
- clocks:		A list of phandle + clock-specifier pairs for the
				clocks listed in clock-names
- clock-names:	Should contain the following:

QCA DUMMY Superspeed USB PHY
=========================
Required properities:
- compatible:   should contain "qca,dummy-ssphy";


QCA DWC3 controller wrapper
===========================
Required properties:
- compatible:	should contain "qca,dwc3"
- clocks:		A list of phandle + clock-specifier pairs for the
				clocks listed in clock-names
- clock-names:	Should contain the following:
  "core"		Master/Core clock, have to be >= 125 MHz for SS
				operation and >= 60MHz for HS operation

Optional clocks:
  "iface"		System bus AXI clock.  Not present on all platforms
  "sleep"		Sleep clock, used when USB3 core goes into low
				power mode (U3).

Required child node:
A child node must exist to represent the core DWC3 IP block. The name of
the node is not important. The content of the node is defined in dwc3.txt.

Example device nodes:
                usb3_ss_phy: ssphy@90000 {
                        compatible = "qca,uni-ssphy";
                        reg = <0x00090000 0x800>;
                        reg-names = "phy_base";
                        resets = <&gcc USB3_UNIPHY_PHY_ARES>;
                        reset-names = "por_rst";
                        qca,host = <1>;
                        qca,emulation = <1>;
                };

                dummy_ss_phy: ssphy@0 {
                        compatible = "qca,dummy-ssphy";
                };

                usb3_hs_phy: hsphy@a6000 {
                        compatible = "qca,baldur-usb3-hsphy";
                        reg = <0xa6000 0x1c0>;
                        reg-names = "phy_base";
                        resets = <&gcc USB3_HSPHY_POR_ARES>, <&gcc USB3_HSPHY_S_ARES>;
                        reset-names = "por_rst", "srif_rst";
                        qca,host = <1>;
                        qca,emulation = <1>;
                };

                usb2_hs_phy: hsphy@a8000 {
                        compatible = "qca,baldur-usb2-hsphy";
                        reg = <0xa8000 0x1c0>;
                        reg-names = "phy_base";
                        resets = <&gcc USB2_HSPHY_POR_ARES>, <&gcc USB2_HSPHY_S_ARES>;
                        reset-names = "por_rst", "srif_rst";
                        qca,host = <1>;
                        qca,emulation = <1>;
                };

                usb3: usb3@8a00000 {
                        compatible = "qca,dwc3";
                        #address-cells = <1>;
                        #size-cells = <1>;
                        ranges;
                        reg = <0x8af8800 0x100>;
                        reg-names = "qscratch_base";
                        clocks = <&gcc 0>,
                                <&gcc 0>,
                                <&gcc 0>,
                                <&gcc 0>,
                                <&gcc 0>;
                        clock-names = "master",
                                "sleep",
                                "mock_utmi",
                                "srif_ahb",
                                "srif_25m";
                        qca,host = <1>;

                        dwc3@8a00000 {
                                compatible = "snps,dwc3";
                                reg = <0x8a00000 0xf8000>;
                                interrupts = <0 132 0>;
                                usb-phy = <&usb3_hs_phy>, <&usb3_ss_phy>;
                                phy-names = "usb2-phy", "usb3-phy";
                                tx-fifo-resize;
                                dr_mode = "host";
                        };
                };
```

## release/src-qca-dakota/linux/linux-3.14.x/arch/arm/mach-qcom/Kconfig
```kconfig
config ARCH_QCOM
	bool "Qualcomm Support" if ARCH_MULTI_V7
	select ARCH_REQUIRE_GPIOLIB
	select ARM_GIC
	select ARM_AMBA
	select CLKSRC_OF
	select GENERIC_CLOCKEVENTS
	select HAVE_SMP
	select PINCTRL
	select MIGHT_HAVE_PCI
	select PCI_DOMAINS if PCI
	select QCOM_SCM if SMP
	select HAVE_IRQ_TIME_ACCOUNTING
	select ARM_HAS_SG_CHAIN
	select HAVE_CC_STACKPROTECTOR
	help
	  Support for Qualcomm's devicetree based systems.

config MSM_PCIE
	bool "MSM PCIe Controller driver"
	depends on PCI && PCI_MSI
	select PCI_DOMAINS
	help
	  Enables the PCIe functionality by configures PCIe core on
	  MSM chipset and by enabling the ARM PCI framework extension.

config MSM_RPM_LOG
	tristate "MSM Resource Power Manager Log Driver"
	depends on MFD_QCOM_RPM
	help
	  This option enables a driver which can read from a circular buffer
	  of messages produced by the RPM. These messages provide diagnostic
	  information about RPM operation. The driver outputs the messages
	  via a debugfs node.

if ARCH_QCOM

menu "Qualcomm SoC Selection"

config ARCH_MSM8X60
	bool "Enable support for MSM8X60"
	select CLKSRC_QCOM

config ARCH_MSM8960
	bool "Enable support for MSM8960"
	select CLKSRC_QCOM

config ARCH_MSM8974
	bool "Enable support for MSM8974"
	select HAVE_ARM_ARCH_TIMER

config ARCH_IPQ40XX
	bool "Enable support for IPQ40XX"
	select HAVE_ARM_ARCH_TIMER

endmenu

endif
```

## release/src-qca-dakota/linux/linux-3.14.x/asus/Kconfig
```kconfig
choice
	prompt "Choose Product"
	help
	   Choose specific product for different hardware layout

config RTAC55U
	bool "RTAC55U (initial porting product)"

config PLN12
	bool "PL-N12 (QCA9533 + AR7420)"

config PLAC56
	bool "PL-AC56 (QCA9563 + QCA9882 + QCA7500)"

config PLAC66U
	bool "PL-AC66U (QCA9563 + QCA9880 + QCA7500)"

config RTAC58U
	bool "RTAC58U (initial porting product)"

config 4GAC53U
	bool "4G-AC53U (initial porting product)"

config RTAC82U
	bool "RTAC82U (initial porting product)"

config MAPAC1300
	bool "MAP-AC1300 (initial porting product)"

config VZWAC1300
	bool "VZW-AC1300 (initial porting product)"

config MAPAC2200
	bool "MAP-AC2200 (initial porting product)"

config MAPAC3000
	bool "MAP-AC3000 (initial porting product)"

endchoice
```

## release/src-qca-dakota/linux/linux-3.14.x/drivers/platform/msm/Kconfig
```kconfig
menu "Qualcomm MSM specific device drivers"
	depends on ARCH_QCOM

config SPS
	bool "SPS support"
	select GENERIC_ALLOCATOR
	help
	  The SPS (Smart Peripheral Switch) is a DMA engine.
	  It can move data in the following modes:
		1. Peripheral-to-Peripheral.
		2. Peripheral-to-Memory.
		3. Memory-to-Memory.

config USB_BAM
	boolean "USB BAM Driver"
	depends on SPS && USB_GADGET
	help
	  Enabling this option adds USB BAM Driver.
	  USB BAM driver was added to supports SPS Peripheral-to-Peripheral
	  transfers between the USB and other peripheral.

config SPS_SUPPORT_BAMDMA
	bool "SPS support BAM DMA"
	depends on SPS
	default n
	help
	  The BAM-DMA is used for Memory-to-Memory transfers.
	  The main use cases is RPC between processors.
	  The BAM-DMA hardware has 2 registers sets:
		1. A BAM HW like all the peripherals.
		2. A DMA channel configuration (i.e. channel priority).

config SPS_SUPPORT_NDP_BAM
	bool "SPS support NDP BAM"
	depends on SPS
	default n
	help
	  No-Data-Path BAM is used to improve BAM performance.

config MSM_BUS_SCALING
	bool "Bus scaling driver"
	default n
	help
	  This option enables bus scaling on MSM devices.  Bus scaling
	  allows devices to request the clocks be set to rates sufficient
	  for the active devices needs without keeping the clocks at max
	  frequency when a slower speed is sufficient.

config BUS_TOPOLOGY_ADHOC
	bool "ad-hoc bus scaling topology"
	default n
	help
	  This option enables a driver that can handle adhoc bus topologies.
	  Adhoc bus topology driver allows one to many connections and maintains
	  directionality of connections by explicitly listing device connections
	  thus avoiding illegal routes.

config BOOTCONFIG_PARTITION
	tristate "BOOTCONFIG Partition support"
	help
	  Say Y here if you would like to use hard disks under Linux which
	  were partitioned using MTD/EFI.

config I2C_MSM_PROF_DBG
	tristate "I2C_MSM_PROF_DBG"
	depends on ARCH_MSM && I2C_MSM_V2
	help
	This option enables the enhanced logging, profiling and debugfs
	support to the i2c-msm-v2 driver. If you say yes to this option,
	you can change the deugging level to adjust the amount of debugging
	information as needed at run time using debugfs.

	This module can also be dynamically linked as a shared kernel object.
endmenu
```
